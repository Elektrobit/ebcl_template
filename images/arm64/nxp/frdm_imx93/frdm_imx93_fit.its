## images/arm64/nxp/frdm_imx93/frdm_imx93_fit.its
```
/dts-v1/;

/ {
    description = "i.MX93 FIT image with kernel, FDT and boot script";
    #address-cells = <1>;

    images {
        kernel {
            description = "Linux kernel (for HAB)";
            data = /incbin/("Image");
            type = "kernel";
            arch = "arm64";
            os = "linux";
            compression = "none";
            load = <0x80400000>;    /* safe for HAB */
            entry = <0x80400000>;
            hash { algo = "sha256"; };
        };

        fdt {
            description = "i.MX93 Device Tree Blob";
            data = /incbin/("imx93-11x11-evk.dtb");
            type = "flat_dt";
            arch = "arm64";
            compression = "none";
            load = <0x83000000>;    /* ~44 MB after kernel */
            hash { algo = "sha256"; };
        };

        bootscr {
            description = "Boot script for auto-boot";
            data = /incbin/("boot.scr");
            type = "script";
            arch = "arm64";
            compression = "none";
            load = <0x83100000>;    /* right after DTB */
            hash { algo = "sha256"; };
        };

        /*
        ramdisk {
            description = "Initial ramdisk";
            data = /incbin/("rootfs.cpio.gz");
            type = "ramdisk";
            arch = "arm64";
            os = "linux";
            compression = "gzip";
            load = <0x83200000>;
            hash { algo = "sha256"; };
        };
        */
    };

    configurations {
        default = "conf";

        conf {
            description = "Boot Linux kernel + FDT + signed bootscr on i.MX93";
            kernel = "kernel";
            fdt = "fdt";
            bootscr = "bootscr";
            /* ramdisk = "ramdisk"; */

            signature {
                algo = "sha256,rsa2048";
                key-name-hint = "ubootkey";
                sign-images = "kernel", "fdt", "bootscr";
            };
        };
    };
};
```

## images/arm64/nxp/frdm_imx93/frdm_imx93_fit_sig.its
```
/dts-v1/;

/ {
    description = "i.MX93 FIT image with signed kernel, FDT and bootscr";
    #address-cells = <1>;

    images {
        kernel {
            description = "Linux kernel (signed)";
            data = /incbin/("Image");
            type = "kernel";
            arch = "arm64";
            os = "linux";
            compression = "none";
            load = <0x80400000>;
            entry = <0x80400000>;

            hash-1 {
                algo = "sha256";
            };
            signature-1 {
                algo = "sha256,rsa2048";
                key-name-hint = "ubootkey";
            };
        };

        fdt {
            description = "i.MX93 Device Tree Blob (signed)";
            data = /incbin/("imx93-11x11-evk.dtb");
            type = "flat_dt";
            arch = "arm64";
            compression = "none";
            load = <0x83000000>;

            hash-1 {
                algo = "sha256";
            };
            signature-1 {
                algo = "sha256,rsa2048";
                key-name-hint = "ubootkey";
            };
        };

        bootscr {
            description = "Boot script (signed)";
            data = /incbin/("boot.cmd");   /* raw ASCII script */
            type = "script";
            arch = "arm64";
            compression = "none";
            load = <0x83100000>;

            hash-1 {
                algo = "sha256";
            };
            signature-1 {
                algo = "sha256,rsa2048";
                key-name-hint = "ubootkey";
            };
        };
    };

    configurations {
        default = "conf";

        conf {
            description = "Boot Linux kernel + FDT + signed bootscr on i.MX93";
            kernel = "kernel";
            fdt = "fdt";
            bootscr = "bootscr";
        };
    };
};
```

## images/common/nxp/rdb2/bootargs.its
```
/dts-v1/;
/ {
  description = "BaseOS Boot Image";
  #address-cells = <1>;
  images {
    kernel-1 {
      description = "Linux kernel image";
      data = /incbin/("Image");
      type = "kernel";
      arch = "arm64";
      os = "linux";
      compression = "none";
      load = <0x80000000>;
      entry = <0x80000000>;
      hash-1 { algo = "md5"; };
    };
    fdt-1 {
      description = "Flattened device tree blob";
      data = /incbin/("target.dtb");
      type = "flat_dt";
      arch = "arm64";
      compression = "none";
      hash-1 { algo = "md5"; };
    };
    ramdisk-1 {
      description = "Initial ramdisk image";
      data = /incbin/("initrd");
      type = "ramdisk";
      arch = "arm64";
      os = "linux";
      compression = "gzip";
      load =  <0x90000000>;
      entry = <0x90000000>;
      hash-1 { algo = "md5"; };
    };
  };
  configurations {
    default = "config-1";
    config-1 {
      description = "Default boot config";
      kernel = "kernel-1";
      ramdisk = "ramdisk-1";
      fdt = "fdt-1";
    };
  };
};
```
