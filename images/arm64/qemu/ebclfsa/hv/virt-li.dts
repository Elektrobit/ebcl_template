/dts-v1/;

/include/ "virt-li-common.dtsi"
/include/ "shm-base.dtsi"

/ {
	virtio_mmio@a003c00 {
		dma-coherent;
		interrupts = <0x00 0x2e 0x04>;
		reg = <0x00 0xa003c00 0x00 0x200>;
		compatible = "virtio,mmio";
		status = "okay";
	};

	virtio_mmio@a003e00 {
		dma-coherent;
		interrupts = <0x00 0x2f 0x04>;
		reg = <0x00 0xa003e00 0x00 0x200>;
		compatible = "virtio,mmio";
		status = "okay";
	};
};
